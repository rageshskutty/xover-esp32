## firmware/main/Kconfig.projbuild
```kconfig
menu "xover-esp32 Configuration"

    choice XOVER_BRINGUP_MODE
        prompt "Bring-up mode"
        default XOVER_BRINGUP_MODE_NONE
        help
            Select the bring-up mode for the xover-esp32 firmware.

        config XOVER_BRINGUP_MODE_NONE
            bool "NONE"
            help
                Mute DAC outputs, log once and idle. No audio is started.

        config XOVER_BRINGUP_MODE_PINWALK
            bool "PINWALK"
            help
                Pin walk test mode (Phase 2). Toggles signal pins one by one for 3 seconds.

        config XOVER_BRINGUP_MODE_I2CSCAN
            bool "I2CSCAN"
            help
                I2C scan test mode (Phase 5). Scans I2C bus every 2 seconds.
    endchoice

    config XOVER_BRINGUP_PINWALK_MUTE
        bool "Include DAC mute pin in pin walk"
        default n
        help
            If enabled, XOVER_PIN_DAC_MUTE_N keeps its 3-second slot last in
            PINWALK mode, but is held low (muted) and never driven high or
            switched to input.

    config XOVER_BRINGUP_MAX_DBFS
        int "Bring-up maximum dBFS level"
        range -120 -30
        default -30
        help
            Cap on test signal level in dBFS for bring-up audio modes.

endmenu
```

## tools/biquad-bench/main/Kconfig.projbuild
```kconfig
menu "Biquad bench"

    config BENCH_WIFI_LOAD
        bool "Run the benchmark under Wi-Fi load (SoftAP plus TCP traffic on core 0)"
        default n
        help
            Adds a Wi-Fi SoftAP and a TCP load server that run on core 0 while the
            unchanged benchmark runs on core 1. Enabled by sdkconfig.wifi only.

    config BENCH_WIFI_SSID
        string "Bench SoftAP SSID"
        depends on BENCH_WIFI_LOAD
        default "xover-bench"

    config BENCH_WIFI_PASS
        string "Bench SoftAP password (8 to 63 characters)"
        depends on BENCH_WIFI_LOAD
        default "xover-bench-0"
        help
            Throwaway password for a SoftAP that has no uplink and exists only
            while the benchmark runs. It protects nothing.

    config BENCH_WIFI_WAIT_S
        int "Seconds to wait for a traffic client before the benchmark starts"
        depends on BENCH_WIFI_LOAD
        range 10 1800
        default 240

endmenu
```

## tools/biquad-bench/sdkconfig.defaults
```kconfig
CONFIG_IDF_TARGET="esp32s3"
CONFIG_ESP_DEFAULT_CPU_FREQ_MHZ_240=y

CONFIG_ESPTOOLPY_FLASHSIZE_16MB=y
CONFIG_ESPTOOLPY_FLASHMODE_QIO=y
CONFIG_ESPTOOLPY_FLASHFREQ_80M=y

CONFIG_SPIRAM=y
CONFIG_SPIRAM_MODE_OCT=y
CONFIG_SPIRAM_SPEED_80M=y

CONFIG_FREERTOS_HZ=1000

CONFIG_ESP_CONSOLE_UART_DEFAULT=y
CONFIG_ESP_CONSOLE_UART_BAUDRATE=115200

CONFIG_ESP_TASK_WDT_TIMEOUT_S=5
CONFIG_ESP_TASK_WDT_CHECK_IDLE_TASK_CPU1=y

CONFIG_COMPILER_OPTIMIZATION_PERF=y

# ---- Wi-Fi load overlay (copy of sdkconfig.wifi), baked in so this CI branch builds the Wi-Fi variant ----
CONFIG_BENCH_WIFI_LOAD=y
CONFIG_ESP_MAIN_TASK_AFFINITY_CPU0=y
CONFIG_ESP_WIFI_TASK_PINNED_TO_CORE_0=y
CONFIG_LWIP_TCPIP_TASK_AFFINITY_CPU0=y
CONFIG_ESP_MAIN_TASK_STACK_SIZE=8192
CONFIG_ESP_TASK_WDT_CHECK_IDLE_TASK_CPU0=n
CONFIG_PARTITION_TABLE_SINGLE_APP_LARGE=y
```
